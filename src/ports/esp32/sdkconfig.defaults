## src/ports/esp32/sdkconfig.defaults
```kconfig
# ESP-IDF v5.5.5 / LVGL v9.3 基础配置（CYD 240x320）

# LVGL：16bit 色深，启用大字号
CONFIG_LV_COLOR_DEPTH_16=y
CONFIG_LV_FONT_MONTSERRAT_16=y
CONFIG_LV_FONT_MONTSERRAT_24=y
CONFIG_LV_FONT_MONTSERRAT_28=y

# 主频 240MHz，Flash 4MB 80MHz QIO（CYD 标配 4MB）
CONFIG_ESPTOOLPY_FLASHMODE_QIO=y
CONFIG_ESPTOOLPY_FLASHFREQ_80M=y
CONFIG_ESPTOOLPY_FLASHSIZE_4MB=y
CONFIG_ESP32_DEFAULT_CPU_FREQ_240=y

# FreeRTOS tick 1000Hz（动画帧时钟精度）
CONFIG_FREERTOS_HZ=1000

# 自定义分区表（factory 2MB，WiFi 固件超 1MB 默认分区）
CONFIG_PARTITION_TABLE_CUSTOM=y
CONFIG_PARTITION_TABLE_CUSTOM_FILENAME="partitions.csv"
CONFIG_PARTITION_TABLE_FILENAME="partitions.csv"
```
